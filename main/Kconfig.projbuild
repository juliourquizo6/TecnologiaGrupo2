## main/Kconfig.projbuild
```kconfig
menu "Configuración del Gestor de Energía"

    config OPERATIVE_HOUR_START
        int "Hora de inicio del horario operativo"
        default 8
        help
            Hora en la que el sistema empieza a funcionar activamente.
    
    config OPERATIVE_HOUR_END
        int "Hora de fin del horario operativo"
        default 22
        help
            Hora en la que el sistema deja de funcionar y entra en modo Deep Sleep.
    
    endmenu
    
    
```

## sdkconfig.defaults
```kconfig
CONFIG_SAMPLE_FREQUENCY=5000
CONFIG_WORKING_HOURS_START=8
CONFIG_WORKING_HOURS_END=22
```
