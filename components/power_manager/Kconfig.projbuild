## components/power_manager/Kconfig.projbuild
```kconfig
menu "Configuración del Monitor de Calidad del Aire"

    config SAMPLE_FREQUENCY
        int "Frecuencia de lectura del sensor (ms)"
        default 1000
        range 100 60000
        help
            Configura la frecuencia de muestreo del sensor en milisegundos.
            Valor mínimo: 100 ms (0.1 segundos)
            Valor máximo: 60000 ms (1 minuto)
    
    config WORKING_HOURS_START
        int "Hora de inicio del funcionamiento (0-23)"
        default 8
        range 0 23
        help
            Hora en formato 24 horas en la que el sistema comienza a operar.
            Ejemplo: 8 significa 8:00 AM.
    
    config WORKING_HOURS_END
        int "Hora de fin del funcionamiento (0-23)"
        default 22
        range 0 23
        help
            Hora en formato 24 horas en la que el sistema deja de operar.
            Ejemplo: 22 significa 10:00 PM.
    
endmenu
```

## components/sgp30/Kconfig.projbuild
```kconfig
menu "Configuracion SGP30"

    config T_LECTURA
        int "Frecuencia de lectura."
        range 0 10000
        default 2000
        help
            Frecuencia de lectura del sensor.

    config T_ENVIO
        int "Frecuencia de envio"
        range 0 10000
        default 2000
        help
            Frecuencia de envio del sensor.

endmenu
```

## components/tb/Kconfig
```kconfig
menu "ThingsBoard Configurations"

    config TB_MQTTS
        bool "Enable MQTTS"
        default n

    config TB_HTTPS
        bool "Enable HTTPS"
        default n

    config TB_DEVICE_NAME
        string "Device name in ThingsBoard"
        default ""

    config TB_PROVISION_DEVICE_KEY
        string "Provisioning device key, you should take it from configured device profile"
        default ""

    config TB_PROVISION_DEVICE_SECRET
        string "Provisioning device secret, you should take it from configured device profile"
        default ""

endmenu
```

## components/tb_client/Kconfig
```kconfig
menu "ThingsBoard Configurations"

    config TB_DEVICE_NAME
        string "Device name in ThingsBoard"
        default ""

    config TB_PROVISION_DEVICE_KEY
        string "Provisioning device key, you should take it from configured device profile"
        default ""

    config TB_PROVISION_DEVICE_SECRET
        string "Provisioning device secret, you should take it from configured device profile"
        default ""

endmenu
```

## components/thingsboard/Kconfig
```kconfig
menu "ThingsBoard Configuration"

    config TB_TIMEOUT_MS
        int "Timeout in milliseconds for blocking operations"
        default 10000
        help
            This option sets the timeout duration in milliseconds for blocking operations
            such as network requests and event handling.

    config TB_PROV_DEVICE_KEY
        string "Provisioning device secret"
        default ""
        help
            This option sets the provisioning device key used during the initial connection
            to the ThingsBoard cloud. It is required for authenticating the device.

    config TB_PROV_DEVICE_SECRET
        string "Provisioning device secret"
        default ""
        help
            This option sets the provisioning device secret used during the initial connection
            to the ThingsBoard cloud. It is required for authenticating the device.

    config TB_TOKEN
        string "Access token"
        default ""
        help
            This option sets the access token used for authenticating the device with the cloud.

endmenu
```

## components/wifi_component/Kconfig.projbuild
```kconfig
menu "Wifi Component Configuration"
    config WIFI_PROVISIONING_USERNAME
        string "Wi-Fi Provisioning Username"
        default "wifiprov" 
        help
            This is the username used for Wi-Fi provisioning.

    config WIFI_PROVISIONING_PASSWORD
        string "Wi-Fi Provisioning Password"
        default "abcd1234" 
        help
            This is the password used for Wi-Fi provisioning.

    config RECONNECT_DELAY_SECONDS
        int "Seconds to wait before trying to reconnect to Wi Fi"
        default 4 
        help
            Number of seconds to wait before trying to reconnect to WiFi after disconnecting.
endmenu
```
